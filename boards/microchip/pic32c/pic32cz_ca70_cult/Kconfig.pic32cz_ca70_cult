## dts/bindings/can/microchip,can-g2-can.yaml
```yaml
# SPDX-FileCopyrightText: Copyright (c) 2026 Microchip Technology Inc.
# SPDX-License-Identifier: Apache-2.0

title: Microchip CAN g2 driver

description: |
  Specialization of Bosch m_can CAN FD controller for Microchip g2
  peripherals.

  Group g2 CAN driver supports following hardware peripherals:
    - module name="MCAN" id="11273" version="G"

compatible: "microchip,can-g2-can"

include:
  - name: bosch,m_can-base.yaml
  - name: pinctrl-device.yaml

properties:
  reg:
    required: true
    description: |
      2 reg blocks needed;
      - Register block for the MCAN configuration registers
      - Register block for the DMA Base Address

  reg-names:
    type: string-array
    required: true
    description: |
      description of reg blocks: m_can, dma_base, message_ram, sram_sel

  interrupts:
    required: true

  interrupt-names:
    required: true

  clocks:
    required: true

examples:
  - |
    /* Definition example: PIC32CZ_CA70 SoC DTSI */
    can0: can@40030000 {
      compatible = "microchip,can-g2-can";
      reg = <0x40030000 0x100>, <0x40088110 0x04>;
      reg-names = "m_can", "dma_base";
      interrupts = <35 0>, <36 0>;
      interrupt-names = "int0", "int1";
      clocks = <&pmc CLOCK_MCHP_MCAN0>;
      clock-names = "mclk";
      bosch,mram-cfg = <0x0 28 8 3 3 0 1 1>;
      status = "disabled";
    };
```

## dts/bindings/clock/microchip/pic32cz_ca70_mc70/microchip,pic32cz-ca70-mc70-clock-generator.yaml
```yaml
# SPDX-FileCopyrightText: Copyright (c) 2026 Microchip Technology Inc.
# SPDX-License-Identifier: Apache-2.0

title: PIC32CZ_CA70 clock generator

description: |
  Microchip Power Management Controller (PMC) Clock Generator block.
  Used to configure the basic clock signals fed into the other
  clock controllers.

compatible: "microchip,pic32cz-ca70-mc70-clock-generator"

include: base.yaml

properties:
  rc-frequency-mhz:
    type: int
    default: 12
    enum:
      - 4
      - 8
      - 12
    description: |
      Frequency of the main RC oscillator, a potential source for
      MAINCK.

  main-oscillator:
    type: string
    default: "rc"
    enum:
      - "rc"
      - "xosc"
      - "xosc-bypass"
    description: |
      Selects the source of MAINCK between the internal RC oscillator,
      the main crystal oscillator, or a bypassed external clock on
      the crystal oscillator pins.

  slow-oscillator:
    type: string
    default: "rc"
    enum:
      - "rc"
      - "xosc"
      - "xosc-bypass"
    description: |
      Selects the source of SLCK between the internal RC oscillator,
      the 32.768 kHz crystal oscillator, or a bypassed external
      clock on the crystal oscillator pins.

  slow-xosc-frequency:
    type: int
    default: 32768
    description: |
      Frequency in Hz of the slow crystal oscillator, used when
      the SLCK oscillator source is XOSC or bypassed XOSC.

  main-xosc-enabled:
    type: boolean
    description: |
      Enables the main crystal oscillator. Required when the UPLL is used.

  main-xosc-startup-cycles:
    type: int
    default: 255
    min: 0
    max: 255
    description: |
      Number of slow clock cycles to wait for the main crystal oscillator
      to stabilize.

  main-xosc-frequency-mhz:
    type: int
    default: 12
    description: |
      Frequency in MHz of the main crystal oscillator.

  upll-enabled:
    type: boolean
    description: |
      Enables the USB PLL during driver initialization.

  upll-startup-cycles:
    type: int
    default: 15
    min: 0
    max: 15
    description: |
      Number of slow clock cycles to wait for the UPLL to lock at startup.

  upll-div:
    type: int
    enum:
      - 1
      - 2
    default: 1
    description: |
      Divider applied to the UPLL output clock.

  plla-multiplier:
    type: int
    default: 0
    min: 0
    max: 2047
    description: |
      Multiplier applied to MAINCK to generate the PLLA output clock.

  plla-lock-count:
    type: int
    default: 63
    min: 0
    max: 63
    description: |
      Number of slow clock cycles to wait for PLLA to lock.

  plla-divider:
    type: int
    default: 0
    min: 0
    max: 255
    description: |
      Divider applied to MAINCK ahead of the PLLA multiplier stage.
      A value of 0 leaves PLLA disabled.
```

## dts/bindings/clock/microchip/pic32cz_ca70_mc70/microchip,pic32cz-ca70-mc70-gclk.yaml
```yaml
# SPDX-FileCopyrightText: Copyright (c) 2026 Microchip Technology Inc.
# SPDX-License-Identifier: Apache-2.0

title: PIC32CZ_CA70 generic clock controller

description: |
  Microchip Generic Clock Controller (GCLK)

  The PMC node in the DTS is expected to have a `gclk` subnode
  with a child for each generic clock that needs to be configured
  in the system.

compatible: "microchip,pic32cz-ca70-mc70-gclk"

include: base.yaml

child-binding:
  description: Generic clock configuration
  properties:
    reg:
      type: array
      required: true
      description: |
        The Peripheral ID corresponding to the selected generic clock

    source:
      type: string
      default: "mainck"
      enum:
        - "slowck"
        - "mainck"
        - "pllack"
        - "upllck"
        - "hostck"
        - "audioclk"
      description: |
        Clock source selected for the generic clock.

    divider:
      type: int
      default: 1
      min: 1
      max: 256
      description: |
        Generic clock division ratio (1-256). GCLK frequency = source / divider.

examples:
  - |
    /* Definition example: PIC32CZ_CA70 SoC DTSI
     * In this example `gclk69` is the generic clock for the peripheral
     * with ID 69, using the mainck as source with no divider.
     */
    gclk: gclk {
      compatible = "microchip,pic32cz-ca70-gclk";

      #address-cells = <1>;
      #size-cells = <0>;

      gclk69: gclk@45 {
        reg = <69>;
        source = "mainck";
        divider = <1>;
      };
    };
```

## dts/bindings/clock/microchip/pic32cz_ca70_mc70/microchip,pic32cz-ca70-mc70-mckr.yaml
```yaml
# SPDX-FileCopyrightText: Copyright (c) 2026 Microchip Technology Inc.
# SPDX-License-Identifier: Apache-2.0

title: PIC32CZ_CA70 host clock controller

description: |
  Microchip Host Clock Controller

compatible: "microchip,pic32cz-ca70-mc70-mckr"

include: base.yaml

properties:
  source:
    type: string
    default: "mainck"
    enum:
      - "slowck"
      - "mainck"
      - "pllack"
      - "upllck"
    description: |
      Input clock source for the Host Clock Controller.

  prescaler:
    type: int
    default: 1
    enum:
      - 1
      - 2
      - 4
      - 8
      - 16
      - 32
      - 64
      - 3
    description: |
      Prescaler applied to the selected source clock.

  main-clock-divider:
    type: int
    default: 1
    enum:
      - 1
      - 2
      - 4
      - 3
    description: |
      Divider applied after the prescaler to generate the
      Master Clock and MCK.
```
