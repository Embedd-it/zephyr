## boards/microchip/pic32c/pic32cz_ca70_cult/Kconfig.pic32cz_ca70_cult
```kconfig
# SPDX-FileCopyrightText: Copyright (c) 2026 Microchip Technology Inc.
# SPDX-License-Identifier: Apache-2.0

config BOARD_PIC32CZ_CA70_CULT
	select SOC_PIC32CZ2051CA70144

if ETH_MCHP_GMAC_G2

config EEPROM
	default y if NVMEM

endif # ETH_MCHP_GMAC_G2

configdefault ETH_DRIVER
	default y
```

## boards/microchip/pic32c/pic32cz_ca70_cult/board.yml
```yaml
# SPDX-FileCopyrightText: Copyright (c) 2026 Microchip Technology Inc.
# SPDX-License-Identifier: Apache-2.0

board:
  name: pic32cz_ca70_cult
  full_name: PIC32CZ CA70 Curiosity Ultra
  vendor: microchip
  socs:
    - name: pic32cz2051ca70144
```

## drivers/can/Kconfig.mchp
```kconfig
# SPDX-FileCopyrightText: Copyright The Zephyr Project Contributors
# SPDX-License-Identifier: Apache-2.0

config CAN_MCHP_MCAN_G1
	bool "Microchip M_CAN G1 driver"
	default y
	depends on DT_HAS_MICROCHIP_MCAN_G1_ENABLED
	depends on CLOCK_CONTROL
	select CAN_MCAN
	select PINCTRL
	help
	  Enable the Microchip M_CAN G1 CAN FD front end.

config CAN_MCHP_CAN_G2
	bool "Microchip g2 CAN driver"
	default y
	depends on DT_HAS_MICROCHIP_CAN_G2_CAN_ENABLED
	select CAN_MCAN
	select PINCTRL
	help
	  This option enables CAN driver for group (g2) of CAN peripherals.
```

## drivers/comparator/Kconfig.mchp
```kconfig
# SPDX-FileCopyrightText: Copyright (c) 2026 Microchip Technology Inc.
# SPDX-License-Identifier: Apache-2.0

config COMPARATOR_MCHP_AC_G1
	bool "Microchip Comparator Driver for AC G1 Peripherals"
	default y
	depends on DT_HAS_MICROCHIP_AC_G1_COMPARATOR_ENABLED
	select PINCTRL
	help
	  Enable support for the Microchip Comparator driver
	  on G1 AC peripherals.

config COMPARATOR_MCHP_ACC_G1
	bool "Microchip Comparator Driver for ACC G1 Peripherals"
	default y
	depends on DT_HAS_MICROCHIP_ACC_G1_COMPARATOR_ENABLED
	select PINCTRL
	help
	  Enable support for the Microchip Comparator driver
	  on G1 ACC peripherals.
```

## drivers/counter/Kconfig.mchp
```kconfig
# SPDX-FileCopyrightText: Copyright (c) 2026 Microchip Technology Inc.
# SPDX-License-Identifier: Apache-2.0

config COUNTER_MCHP_G1_TCC
	bool "Microchip TCC G1 Counter driver"
	default y
	depends on DT_HAS_MICROCHIP_TCC_G1_COUNTER_ENABLED
	help
	  This option enables the counter driver for Microchip timer peripherals

config COUNTER_MCHP_TC_G1
	bool "Microchip TC G1 Counter driver"
	default y
	depends on DT_HAS_MICROCHIP_TC_G1_COUNTER_ENABLED
	help
	  This option enables the counter driver for Microchip timer peripherals.

config COUNTER_MCHP_RTC_G1
	bool "Microchip RTC G1 Counter driver"
	default y
	depends on DT_HAS_MICROCHIP_RTC_G1_COUNTER_ENABLED
	help
	  This option enables the counter driver for Microchip timer peripherals

config COUNTER_MCHP_RTC_G2
	bool "Microchip RTC G2 Counter driver"
	default y
	depends on DT_HAS_MICROCHIP_RTC_G2_COUNTER_ENABLED
	help
	  Enable the Counter-API driver for the Microchip PIC32CZ CA70 RTC
	  peripheral, exposing its calendar as a Unix-timestamp tick counter.

config COUNTER_MCHP_TC_G2
	bool "Microchip Timer Counter (TC) g2 driver"
	default y
	depends on DT_HAS_MICROCHIP_TC_G2_COUNTER_ENABLED
	help
	  Enable the Microchip Timer Counter g2 driver.

config COUNTER_MCHP_TC_G3
	bool "Microchip Timer Counter (TC) g3 driver"
	default y
	depends on DT_HAS_MICROCHIP_TC_G3_COUNTER_ENABLED
	select COUNTER_SUPPORTS_CAPTURE
	help
	  Enable the Microchip Timer Counter g3 driver.
```

## drivers/crypto/Kconfig.mchp
```kconfig
# Copyright (c) 2022 Intel Corporation
# SPDX-License-Identifier: Apache-2.0

config CRYPTO_MCHP_AES_G1
	bool "Microchip SAM AES driver"
	default y
	depends on DT_HAS_MICROCHIP_AES_G1_ENABLED
	help
	  Enable Microchip SAM Advanced Encryption Standard (AES) driver.

config CRYPTO_MCHP_AES_G2
	bool "Microchip G2 AES driver"
	default y if DT_HAS_MICROCHIP_AES_G2_CRYPTO_ENABLED
	help
	  Enable Microchip G2 Advanced Encryption Standard (AES) driver.

config CRYPTO_MCHP_AES_G2_DMA
	bool "Microchip G2 AES driver DMA support"
	depends on CRYPTO_MCHP_AES_G2
	select DMA
	help
	  Let the DMA controller feed the AES peripheral's input data register
	  (AES_IDATAR0) and drain its output data register (AES_ODATAR) into
	  the caller's buffer, instead of the CPU handling each block from
	  software, as described in the "DMA Mode" section of the datasheet.
	  Requires the devicetree node to have "tx" and "rx" entries in its
	  "dmas" property.

config CRYPTO_MCHP_SHA_G1
	bool "Microchip SAM SHA driver"
	default y
	depends on DT_HAS_MICROCHIP_SHA_G1_CRYPTO_ENABLED
	help
	  Enable Microchip SAM Secure Hash Algorithm (SHA) driver.

config CRYPTO_MCHP_ICM_G1
	bool "Microchip G1 ICM driver"
	default y if DT_HAS_MICROCHIP_ICM_G1_CRYPTO_ENABLED
	help
	  Enable Microchip G1 Integrity Check Monitor (ICM) driver.

config CRYPTO_MCHP_XEC_SYMCR
	bool "Microchip XEC symmetric crypto (AES/Hash) driver"
	default y
	depends on DT_HAS_MICROCHIP_XEC_SYMCR_ENABLED
	help
	  Enable Microchip XEC symmetric crypto (AES/Hash) driver.
	  Symmetric crypto provides a single hardware interface
	  to AES and hash engines.

if CRYPTO_MCHP_ICM_G1

config CRYPTO_MCHP_ICM_G1_MAX_DESCRIPTORS
	int "Microchip G1 ICM Driver maximum number of input descriptors"
	default 4
	range 2 1024
	help
	  The ICM peripheral can calculate an hash over a list of descriptors,
	  each pointing to some data. The list allows to express a non
	  contiguous input buffer. At least two descriptors are needed: one for
	  the input data and one for the likely required padding buffer.

endif # CRYPTO_MCHP_ICM_G1
```

## drivers/ethernet/Kconfig.mchp
```kconfig
# SPDX-FileCopyrightText: Copyright (c) 2026 Microchip Technology Inc.
# SPDX-License-Identifier: Apache-2.0

# Define menu symbol for configuring ethernet features
menuconfig ETH_MCHP_GMAC_G1
	bool "Microchip G1 Ethernet driver"
	default y
	depends on NET_BUF_FIXED_DATA_SIZE
	depends on DT_HAS_MICROCHIP_GMAC_G1_ETH_ENABLED
	select ETH_PHY_DRIVER
	select NOCACHE_MEMORY if ARCH_HAS_NOCACHE_MEMORY_SUPPORT && DCACHE
	select PINCTRL
	select NET_CHECKSUM_OFFLOAD_SUPPORTED if NET_L2_ETHERNET
	imply NVMEM if $(dt_compat_any_has_prop,$(DT_COMPAT_MICROCHIP_GMAC_G1_ETH),nvmem-cells)
	help
	  Enable Microchip MCU Family Ethernet driver.

if ETH_MCHP_GMAC_G1

config ETH_MCHP_BUF_RX_COUNT
	int "Network RX buffers preallocated by the SAM ETH driver"
	default 12
	help
	  Number of network buffers that will be permanently allocated by the
	  Ethernet driver. These buffers are used in receive path. They are
	  preallocated by the driver and made available to the GMAC module to be
	  filled in with incoming data. Their number has to be large enough to fit
	  at least one complete Ethernet frame. SAM ETH driver will always allocate
	  that amount of buffers for itself thus reducing the NET_BUF_RX_COUNT
	  which is a total amount of RX data buffers used by the whole networking
	  stack. One has to ensure that NET_PKT_RX_COUNT is large enough to
	  fit at least two Ethernet frames: one being received by the GMAC module
	  and the other being processed by the higher layer networking stack.

config ETH_MCHP_RX_THREAD_STACK_SIZE
	int "MCHP RX Work thread stack size"
	default 1600
	help
	  RX thread stack size in bytes.

config ETH_MCHP_RX_THREAD_PRIORITY
	int "MCHP RX work thread priority"
	default 2
	help
	  Ethernet Driver handles RX in thread.
	  This options sets the priority of that thread.

endif # ETH_MCHP_GMAC_G1

menuconfig ETH_MCHP_GMAC_G2
	bool "Microchip GMAC ethernet driver"
	default y
	depends on NET_BUF_FIXED_DATA_SIZE
	depends on DT_HAS_MICROCHIP_GMAC_G2_ETH_ENABLED
	select ETH_PHY_DRIVER
	select PINCTRL
	imply NVMEM if ($(dt_compat_any_has_prop,$(DT_COMPAT_MICROCHIP_GMAC_G2_ETH),nvmem-cells))
	help
	  Enable GMAC/Ethernet driver support for Microchip MCUs.

if ETH_MCHP_GMAC_G2

# Workaround for not being able to have commas in macro arguments
DT_ETH_MCHP_GMAC_PATH := $(dt_nodelabel_path,gmac)

# Just for readability, to keep the following lines shorter.
DT_ETH_MCHP_GMAC_NQ := $(dt_node_int_prop_int,$(DT_ETH_MCHP_GMAC_PATH),num-queues)

config ETH_MCHP_GMAC_G2_QUEUES
	int "Number of active hardware TX and RX queues"
	default 1
	range 1 $(DT_ETH_MCHP_GMAC_NQ)
	help
	  Select the number of hardware queues used by the driver. Packets will be
	  routed to appropriate queues based on their priority.

config ETH_MCHP_GMAC_G2_FORCE_QUEUE
	bool "Force all traffic to be routed through a specific queue"
	depends on ETH_MCHP_GMAC_G2_QUEUES > 1
	depends on NET_TC_RX_COUNT < 5
	help
	  This option is meant to be used only for debugging. Use it to force all
	  traffic to be routed through a specific hardware queue. With this enabled
	  it is easier to verify whether the chosen hardware queue actually works.
	  This works only if there are four or fewer RX traffic classes enabled, as
	  the SAM GMAC hardware supports screening up to four traffic classes.

config ETH_MCHP_GMAC_G2_FORCED_QUEUE
	int "Queue to force the packets to"
	depends on ETH_MCHP_GMAC_G2_FORCE_QUEUE
	default 0
	range 0 1 if ETH_MCHP_GMAC_G2_QUEUES = 2
	range 0 2 if ETH_MCHP_GMAC_G2_QUEUES = 3
	range 0 3 if ETH_MCHP_GMAC_G2_QUEUES = 4
	range 0 4 if ETH_MCHP_GMAC_G2_QUEUES = 5
	range 0 5 if ETH_MCHP_GMAC_G2_QUEUES = 6
	help
	  Which queue to force the routing to. This affects both the TX and RX queues
	  setup.

config ETH_MCHP_GMAC_G2_BUF_RX_COUNT
	int "Network RX buffers preallocated by the Microchip ETH driver"
	default 12
	help
	  Number of network buffers that will be permanently allocated by the
	  Ethernet driver. These buffers are used in receive path. They are
	  preallocated by the driver and made available to the GMAC module to be
	  filled in with incoming data. Their number has to be large enough to fit
	  at least one complete Ethernet frame. Microchip ETH driver will always allocate
	  that amount of buffers for itself thus reducing the NET_BUF_RX_COUNT
	  which is a total amount of RX data buffers used by the whole networking
	  stack. One has to ensure that NET_PKT_RX_COUNT is large enough to
	  fit at least two Ethernet frames: one being received by the GMAC module
	  and the other being processed by the higher layer networking stack.

config ETH_MCHP_GMAC_G2_PTP_CLOCK
	bool "Microchip GMAC PTP clock driver support"
	default y
	depends on PTP_CLOCK
	help
	  Enable Microchip GMAC PTP Clock support.

endif # ETH_MCHP_GMAC_G2
```

## drivers/ethernet/mdio/Kconfig.mchp
```kconfig
# SPDX-FileCopyrightText: Copyright (c) 2026 Microchip Technology Inc.
# SPDX-License-Identifier: Apache-2.0

config MDIO_MCHP_GMAC_G1
	bool "Microchip MDIO driver"
	depends on DT_HAS_MICROCHIP_GMAC_G1_MDIO_ENABLED
	depends on ETH_MCHP_GMAC_G1
	default y
	help
	  Enable Microchip MCU Family MDIO driver.

config MDIO_MCHP_GMAC_G2
	bool "Microchip GMAC/MDIO driver"
	default y
	depends on DT_HAS_MICROCHIP_GMAC_G2_MDIO_ENABLED
	depends on ETH_MCHP_GMAC_G2
	select PINCTRL
	help
	  Enable GMAC/MDIO driver support for Microchip MCUs.
```

## drivers/gpio/Kconfig.mchp
```kconfig
# SPDX-FileCopyrightText: Copyright (c) 2025-2026 Microchip Technology Inc.
# SPDX-License-Identifier: Apache-2.0

config GPIO_MCHP_PORT_G1
	bool "Microchip PORT G1 GPIO driver"
	default y
	depends on DT_HAS_MICROCHIP_PORT_G1_GPIO_ENABLED
	help
	  This option enables GPIO driver for group (g1) of PORT peripherals.

config GPIO_MCHP_PIO_G1
	bool "Microchip PIO G1 GPIO driver"
	default y
	depends on DT_HAS_MICROCHIP_PIO_G1_GPIO_ENABLED
	select PINCTRL
	help
	  This option enables GPIO driver for group (g1) of PIO peripherals.
```

## drivers/hwinfo/Kconfig.mchp
```kconfig
# SPDX-FileCopyrightText: Copyright (c) 2025-2026 Microchip Technology Inc.
# SPDX-License-Identifier: Apache-2.0

config HWINFO_MCHP_G1
	bool "Microchip hwinfo"
	default y
	depends on DT_HAS_MICROCHIP_HWINFO_G1_ENABLED || \
		   DT_HAS_MICROCHIP_RSTC_G1_RESET_ENABLED
	select HWINFO_HAS_DRIVER
	help
	  Enable mchp hwinfo driver

config HWINFO_MCHP_CHIPID_G1
	bool "Microchip CHIPID g1 hwinfo"
	default y
	depends on DT_HAS_MICROCHIP_CHIPID_G1_HWINFO_ENABLED || \
			DT_HAS_MICROCHIP_RSTC_G2_RESET_ENABLED
	select HWINFO_HAS_DRIVER
	help
	  Enable Microchip CHIPID g1 hwinfo driver
```

## drivers/i2c/Kconfig.mchp
```kconfig
# SPDX-FileCopyrightText: Copyright (c) 2025-2026 Microchip Technology Inc.
# SPDX-License-Identifier: Apache-2.0

config I2C_MCHP_SERCOM
	bool
	help
	  Common options for Microchip I2C SERCOM drivers.

config I2C_MCHP_SERCOM_G1
	bool
	default y
	depends on DT_HAS_MICROCHIP_SERCOM_G1_I2C_ENABLED
	select PINCTRL
	select I2C_MCHP_SERCOM
	help
	  Enable support for Microchip SERCOM I2C g1 driver.

if I2C_MCHP_SERCOM

config I2C_MCHP_DMA_DRIVEN
	bool
	default y
	depends on DMA
	depends on $(dt_compat_any_has_prop,$(DT_COMPAT_MICROCHIP_SERCOM_G1_I2C),dmas)
	help
	  This enables DMA driven transfers for the I2C peripheral.
	  Requires DMA controller and dmas property in device tree.
	  It can be used in blocking and non-blocking modes.

config I2C_MCHP_TARGET_BUFF_SIZE
	int "Microchip I2C Target buffer size"
	default 64
	depends on I2C_TARGET_BUFFER_MODE
	range 1 512
	help
	  Size of the I2C target buffer in bytes which is used by the Microchip
	  I2C driver when operating in target mode.
	  Increase this value if you expect large read/write transfers from
	  the I2C controller. Decrease it to save memory.

config I2C_MCHP_TRANSFER_TIMEOUT
	int "Microchip Transfer timeout [ms]"
	default 500
	help
	  Timeout in milliseconds used for each I2C transfer.
	  0 means that the driver should use the K_FOREVER value,
	  i.e. it should wait as long as necessary.

endif # I2C_MCHP_SERCOM

config I2C_MCHP_INTERRUPT_DRIVEN
	bool "Interrupt support for Microchip I2C devices"
	depends on !I2C_MCHP_DMA_DRIVEN
	help
	  This enables INTERRUPT driven transactions for the I2C peripheral.
	  interrupt driven mode can be used in blocking & non blocking mode.

config I2C_MCHP_TARGET
	bool "Target device support for Microchip I2C devices"
	default y
	depends on I2C_TARGET
	help
	  This enables target device support for the I2C peripheral.

config I2C_MCHP_TWIHS_G1
	bool
	default y
	depends on DT_HAS_MICROCHIP_TWIHS_G1_I2C_ENABLED
	select PINCTRL
	help
	  Enable support for Microchip I2C/TWIHS driver.

config I2C_MCHP_TWIHS_G1_DMA
	bool "DMA support for Microchip I2C/TWIHS devices"
	default y
	depends on I2C_MCHP_TWIHS_G1
	depends on DMA
	help
	  This enables DMA driven transactions for the I2C peripheral.
	  DMA driven mode requires fewer interrupts to handle the
	  transaction and ensures that high speed modes are not delayed
	  by data reloading.
```

## drivers/i2s/Kconfig.mchp
```kconfig
# SPDX-FileCopyrightText: Copyright (c) 2026 Microchip Technology Inc.
# SPDX-License-Identifier: Apache-2.0

menuconfig I2S_MCHP_I2SC_G1
	bool "Microchip MCU family I2SC Bus Driver"
	default y
	depends on DT_HAS_MICROCHIP_I2SC_G1_I2S_ENABLED
	select PINCTRL
	select DMA
	select CLOCK_CONTROL_MCHP_SET_RATE
	select CLOCK_CONTROL_MCHP_GET_RATE
	select CLOCK_CONTROL_MCHP_CONFIG_RUNTIME
	help
	  Enable Inter Sound (I2S) bus driver for Microchip MCU family.

if I2S_MCHP_I2SC_G1

config I2S_MCHP_I2SC_G1_RX_BLOCK_COUNT
	int "RX block queue length"
	default 4

config I2S_MCHP_I2SC_G1_TX_BLOCK_COUNT
	int "TX block queue length"
	default 4

config I2S_MCHP_I2SC_G1_COMBINED_DRAIN
	bool "Keep RX running until TX drain completes for I2S_DIR_BOTH"
	default y
	help
	  On this peripheral, RX and TX share a common clock and cannot be
	  triggered independently. When DRAIN is issued for I2S_DIR_BOTH,
	  stopping RX as soon as its current block completes would discard
	  data that TX is still clocking out. Enable this option to keep the
	  RX stream running and capturing data until the TX stream has fully
	  drained its queue, so both streams stop together.

endif
```
