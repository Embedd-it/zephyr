## drivers/mspi/Kconfig.mchp
```kconfig
# SPDX-FileCopyrightText: Copyright (c) 2026 Microchip Technology Inc.
# SPDX-License-Identifier: Apache-2.0

config MSPI_MCHP_QSPI_G1
	bool "Microchip Multi-bit SPI (QUADSPI) Controller driver"
	depends on DT_HAS_MICROCHIP_QSPI_G1_MSPI_ENABLED
	depends on !MSPI_ASYNC
	default y
	help
	  QUADSPI / Multi-bit SPI driver support for Microchip.

if MSPI_MCHP_QSPI_G1

config MSPI_MCHP_QSPI_G1_WAIT_FOR_COMPLETION_MS
	int "Timeout for wait for completion"
	default 1000
	help
	  Timeout for wait for completion

endif
```

## drivers/reset/Kconfig.mchp
```kconfig
# SPDX-FileCopyrightText: Copyright (c) 2026 Microchip Technology Inc.
# SPDX-License-Identifier: Apache-2.0

config RESET_MCHP_RSTC_G1
	bool "Microchip RSTC G1 reset driver"
	default y
	depends on DT_HAS_MICROCHIP_RSTC_G1_RESET_ENABLED
	help
	  Enable RESET driver for Microchip G1.

config RESET_MCHP_RSTC_G2
	bool "Microchip RSTC G2 reset driver"
	default y
	depends on DT_HAS_MICROCHIP_RSTC_G2_RESET_ENABLED
	help
	  Enable RESET driver for Microchip G2.
```

## drivers/sdhc/Kconfig.mchp
```kconfig
# SPDX-FileCopyrightText: Copyright (c) 2026 Microchip Technology Inc.
# SPDX-License-Identifier: Apache-2.0

config SDHC_MCHP_G1
	bool "Microchip SDHC G1 driver"
	default y
	depends on DT_HAS_MICROCHIP_SDHC_G1_ENABLED
	select PINCTRL
	select SDHC_SUPPORTS_NATIVE_MODE
	help
	  Enable the Microchip SDHC MMC/SD card G1 driver.

config SDHC_MCHP_HSMCI_G1
	bool "Microchip HSMCI G1 driver"
	default y
	depends on DT_HAS_MICROCHIP_HSMCI_G1_SDHC_ENABLED
	select PINCTRL
	select SDHC_SUPPORTS_NATIVE_MODE
	help
	  Enable the Microchip HSMCI MMC/SD card driver.

if SDHC_MCHP_HSMCI_G1

config SDHC_MCHP_HSMCI_G1_DMA
	bool "Microchip HSMCI SDHC driver DMA support"
	default n
	select DMA
	help
	  Use the DMA controller to move block-transfer data between the
	  HSMCI FIFO memory aperture (HSMCI_FIFO) and the caller's buffer,
	  instead of the CPU polling TXRDY/RXRDY for every byte/word.

config SDHC_MCHP_HSMCI_G1_PWRSAVE
	bool "Power save during card inactive"
	default y
	help
	  Power-save mode reduces the clock-speed during SD card
	  inactivity.

if SDHC_MCHP_HSMCI_G1_PWRSAVE

config SDHC_MCHP_HSMCI_G1_PWRSAVE_DIV
	int "Divisor value of clock when in power-save mode"
	default 7
	range 0 7
	help
	  SD clock frequency is divided by 2**(N+1) where N
	  is the divisor value. Valid values are 0 to 7.

endif # SDHC_MCHP_HSMCI_G1_PWRSAVE_DIV

endif # SDHC_MCHP_HSMCI_G1
```

## drivers/serial/Kconfig.mchp
```kconfig
# SPDX-FileCopyrightText: Copyright (c) 2025-2026 Microchip Technology Inc.
# SPDX-License-Identifier: Apache-2.0

config UART_MCHP_SERCOM_G1
	bool
	default y
	depends on DT_HAS_MICROCHIP_SERCOM_G1_UART_ENABLED
	select SERIAL_HAS_DRIVER
	select SERIAL_SUPPORT_INTERRUPT
	select SERIAL_SUPPORT_ASYNC
	select PINCTRL
	help
	  This option enables UART driver for group (g1) of SERCOM peripherals.

config UART_MCHP_UART_G2
	bool
	default y
	depends on DT_HAS_MICROCHIP_UART_G2_UART_ENABLED
	select SERIAL_HAS_DRIVER
	select SERIAL_SUPPORT_INTERRUPT
	select SERIAL_SUPPORT_ASYNC
	select PINCTRL
	help
	  This option enables UART driver for group (g2) of UART peripherals.

config UART_MCHP_USART_G1
	bool
	default y
	depends on DT_HAS_MICROCHIP_USART_G1_UART_ENABLED
	select SERIAL_HAS_DRIVER
	select SERIAL_SUPPORT_INTERRUPT
	select SERIAL_SUPPORT_ASYNC
	select PINCTRL
	help
	  This option enables USART driver for group (g1) of USART peripherals.

if UART_MCHP_SERCOM_G1 || UART_MCHP_UART_G2 || UART_MCHP_USART_G1

config UART_MCHP_ASYNC
	bool
	default y
	depends on UART_ASYNC_API
	depends on DMA
	depends on $(dt_compat_any_has_prop,$(DT_COMPAT_MICROCHIP_SERCOM_G1_UART),dmas) || \
		$(dt_compat_any_has_prop,$(DT_COMPAT_MICROCHIP_UART_G2_UART),dmas) || \
		$(dt_compat_any_has_prop,$(DT_COMPAT_MICROCHIP_USART_G1_UART),dmas)
	help
	  Enable async/DMA support for UART instances that have dmas property.
	  Instances without dmas property will return -ENOTSUP for async operations.

config UART_MCHP_USART_G1_ASYNC_EVT_QUEUE_DEPTH
	int "USART (g1) async event queue depth"
	default 16
	range 4 256
	depends on UART_MCHP_USART_G1 && UART_MCHP_ASYNC
	help
	  Number of async UART events that can be pending per USART (g1) instance.
	  Events raised in interrupt context are queued and delivered to the
	  application callback from the system workqueue. RX buffers must be large
	  enough to cover the workqueue latency at the configured baudrate.

config UART_MCHP_UART_G2_ASYNC_EVT_QUEUE_DEPTH
	int "UART (g2) async event queue depth"
	default 16
	range 4 256
	depends on UART_MCHP_UART_G2 && UART_MCHP_ASYNC
	help
	  Number of async UART events that can be pending per UART (g2) instance.
	  Events raised in interrupt context are queued and delivered to the
	  application callback from the system workqueue. RX buffers must be large
	  enough to cover the workqueue latency at the configured baudrate.

endif # UART_MCHP_SERCOM_G1 || UART_MCHP_UART_G2 || UART_MCHP_USART_G1

config UART_MCHP_DBGU_G1
	bool "Microchip SAM Debug Unit (DBGU) driver"
	default y
	depends on DT_HAS_MICROCHIP_DBGU_G1_UART_ENABLED
	select SERIAL_HAS_DRIVER
	help
	  This option enables UART driver for group (g1) of DBGU peripherals.

config UART_MCHP_UART_G1
	bool "Microchip SAM UART (uart-g1) driver"
	default y
	depends on DT_HAS_MICROCHIP_UART_G1_ENABLED
	select SERIAL_HAS_DRIVER
	select SERIAL_SUPPORT_INTERRUPT
	select PINCTRL
	help
	  This option enables UART driver for group (g1) of UART peripherals.
```

## drivers/spi/Kconfig.mchp
```kconfig
# SPDX-FileCopyrightText: Copyright (c) 2026 Microchip Technology Inc.
# SPDX-License-Identifier: Apache-2.0

config SPI_MCHP_FLEXCOM_G1
	bool "Microchip FLEXCOM SPI driver"
	default y
	depends on DT_HAS_MICROCHIP_FLEXCOM_G1_SPI_ENABLED
	select PINCTRL
	select GPIO
	help
	  Enable support for the Microchip FLEXCOM SPI driver.

config SPI_MCHP_FLEXCOM_DMA_DRIVEN
	bool "Microchip FLEXCOM SPI DMA Mode"
	default y
	depends on SPI_MCHP_FLEXCOM_G1
	depends on $(dt_compat_all_has_prop,$(DT_COMPAT_MICROCHIP_FLEXCOM_G1_SPI),dmas)
	select DMA
	help
	  This enables DMA driven transfers for the SPI peripheral.
	  Requires DMA controller and dmas property in device tree.

config SPI_MCHP_SERCOM
	bool
	help
	  Common options for Microchip SPI SERCOM drivers.

config SPI_MCHP_SERCOM_G1
	bool
	default y
	depends on DT_HAS_MICROCHIP_SERCOM_G1_SPI_ENABLED
	select PINCTRL
	select GPIO
	select SPI_MCHP_SERCOM
	help
	  Enable support for the Microchip SERCOM SPI driver.

if SPI_MCHP_SERCOM

config SPI_MCHP_INTER_CHARACTER_SPACE
	int "Microchip SERCOM SPI Inter-Character Spacing (in clock cycles)"
	default 63 if SPI_PERIPHERAL
	default 0
	range 0 63
	depends on SOC_FAMILY_MICROCHIP_SAM_D5X_E5X || SOC_FAMILY_MICROCHIP_PIC32CZ_CA
	help
	  Number of clock cycles to delay between characters on SPI bus.

config SPI_MCHP_DMA_DRIVEN
	bool "Microchip SPI DMA Mode"
	default y
	depends on DMA
	depends on $(dt_compat_all_has_prop,$(DT_COMPAT_MICROCHIP_SERCOM_G1_SPI),dmas)
	help
	  This enables DMA driven transfers for the SPI peripheral.
	  Requires DMA controller and dmas property in device tree.

endif # SPI_MCHP_SERCOM

config SPI_MCHP_G1
	bool "Microchip SPI driver"
	default y
	depends on DT_HAS_MICROCHIP_SPI_G1_ENABLED
	select PINCTRL
	help
	  Enable support for the SPI driver.
	  Polling mode (SPI host only) is the default due to missing FIFO.

config SPI_MCHP_G1_INTERRUPT
	bool "Microchip SPI driver in interrupt mode"
	default n
	depends on SPI_MCHP_G1
	depends on !SPI_MCHP_G1_DMA
	help
	  Enable interrupt mode for the SPI driver, supports both SPI Host/Target.
	  Disabled by default.

config SPI_MCHP_G1_DMA
	bool "Microchip SPI driver in DMA mode"
	default y
	depends on SPI_MCHP_G1
	select DMA
	help
	  Enable DMA mode for the SPI driver.

if SPI_MCHP_G1

config SPI_MCHP_G1_CHECK_TIME
	int "Timeout (us) used in WAIT_FOR to check bits in status register"
	default 1000000
	help
	  This value need to be changed, depending on selected baudrate

if SPI_RTIO

config MCHP_SPI_RTIO_SQ_SIZE
	int "Number of available submission queue entries"
	default 8 # Sensible default that covers most common spi transactions
	help
	  When RTIO is use with SPI each driver holds a context with which blocking
	  API calls use to perform SPI transactions. This queue needs to be as deep
	  as the longest set of spi_buf_sets used, where normal SPI operations are
	  used (equal length buffers). It may need to be slightly deeper where the
	  spi buffer sets for transmit/receive are not always matched equally in
	  length as these are transformed into normal transceives.

endif # SPI_RTIO

endif # SPI_MCHP_G1
```

## drivers/usb/udc/Kconfig.mchp
```kconfig
# SPDX-FileCopyrightText: Copyright (c) 2026 Microchip Technology Inc.
# SPDX-License-Identifier: Apache-2.0

config UDC_MCHP_UDPHS_G1
	bool "Microchip USB Device High Speed Port (UDPHS) G1"
	default y
	depends on DT_HAS_MICROCHIP_UDPHS_G1_UDC_ENABLED
	select PINCTRL
	select GPIO
	select SYS_MEM_BLOCKS
	select EVENTS
	select UDC_DRIVER_HAS_HIGH_SPEED_SUPPORT
	help
	  Enable the Microchip UDPHS G1 driver.

if UDC_MCHP_UDPHS_G1

config UDC_MCHP_UDPHS_G1_STACK_SIZE
	int "UDC controller driver internal thread stack size"
	default 1024
	help
	  Device controller driver internal thread stack size.

config UDC_MCHP_UDPHS_G1_THREAD_PRI
	int "UDC controller driver thread priority"
	default 8
	help
	  Device controller driver thread priority.

config UDC_MCHP_UDPHS_G1_DMA
	bool "DMA support"
	default y
	help
	  Enable DMA transfer, otherwise data will be transferred via FIFO.

config UDC_MCHP_UDPHS_G1_BURST_LOCK
	bool "Lock bus access for maximum bandwidth"
	help
	  USB packets system data bursts will be locked for
	  maximum optimization of the bus bandwidth usage.

endif # UDC_MCHP_UDPHS_G1

DT_UDC_MCHP_USBHS_G2_HAS_HIGH_SPEED := $(dt_compat_any_has_prop,$(DT_COMPAT_MICROCHIP_USBHS_G2_UDC),maximum-speed,high-speed)

config UDC_MCHP_USBHS_G2
	bool "PIC32CZ CA70 USBHS USB Device Controller driver"
	default y
	depends on DT_HAS_MICROCHIP_USBHS_G2_UDC_ENABLED && !SOC_PIC32CZ2051CA70064
	select EVENTS
	select UDC_DRIVER_HAS_HIGH_SPEED_SUPPORT if $(DT_UDC_MCHP_USBHS_G2_HAS_HIGH_SPEED)
	help
	  PIC32CZ CA70 family USBHS device controller driver.

	  The driver support High-Speed (480 Mbps) and Full-Speed (12 Mbps)
	  operation. The peripheral does not work on the 64-pin TFQ package devices
	  (see the PIC32CZ CA70/MC70 Family Silicon Errata and Data Sheet
	   Clarifications, section 2.3)

if UDC_MCHP_USBHS_G2

config UDC_MCHP_USBHS_G2_STACK_SIZE
	int "UDC controller driver internal thread stack size"
	default 512
	help
	  Device controller driver internal thread stack size.

config UDC_MCHP_USBHS_G2_THREAD_PRIORITY
	int "UDC controller driver thread priority"
	default 8
	help
	  Device controller driver thread priority.

config UDC_MCHP_USBHS_G2_DMA
	bool "Hardware DMA for data endpoints"
	default y
	help
	  Use the USBHS peripheral's built-in DMA channels to move IN/OUT
	  data instead of the CPU byte-copy loop. The peripheral has 7 DMA
	  channels hard-wired one-to-one to hardware endpoints 1..7; EP0 and
	  any configured endpoint beyond hardware endpoint 7 always use the
	  CPU-copy path regardless of this option.

endif # UDC_MCHP_USBHS_G2
```

## drivers/usb/uhc/Kconfig.mchp
```kconfig
# SPDX-FileCopyrightText: Copyright (c) 2026 Microchip Technology Inc.
# SPDX-License-Identifier: Apache-2.0

config UHC_MCHP_USBHS_G2
	bool "Microchip USBHS g2 driver"
	default y
	depends on DT_HAS_MICROCHIP_USBHS_G2_UHC_ENABLED && !SOC_PIC32CZ2051CA70064
	select EVENTS
	help
	  This option enables the Microchip USBHS USB Host Controller driver
	  for the PIC32CZ CA70 family USBHS Peripheral.

	  The driver support High-Speed (480 Mbps) and Full-Speed (12 Mbps)
	  operation. The peripheral does not work on the 64-pin TFQ package devices
	  (see the PIC32CZ CA70/MC70 Family Silicon Errata and Data Sheet
	   Clarifications, section 2.3)

if UHC_MCHP_USBHS_G2

config UHC_MCHP_USBHS_G2_THREAD_STACK_SIZE
	int "Driver internal thread stack size"
	default 512
	help
	  Size of the stack used in the driver.

config UHC_MCHP_USBHS_G2_THREAD_PRIORITY
	int "UHC controller driver thread priority"
	default 8
	help
	  Host controller driver thread priority.

config UHC_MCHP_USBHS_G2_DMA
	bool "Hardware DMA for data endpoints"
	default y
	help
	  Use the USBHS peripheral's built-in DMA channels to move IN/OUT
	  data instead of the CPU byte-copy loop. The peripheral has 7 DMA
	  channels hard-wired one-to-one to hardware endpoints 1..7; EP0 and
	  any configured endpoint beyond hardware endpoint 7 always use the
	  CPU-copy path regardless of this option.

endif # UHC_MCHP_USBHS_G2
```

## drivers/watchdog/Kconfig.mchp
```kconfig
# SPDX-FileCopyrightText: Copyright (c) 2025-2026 Microchip Technology Inc.
# SPDX-License-Identifier: Apache-2.0

config WDT_MCHP_G1
	bool "Microchip G1 Watchdog (WDT) Driver"
	default y
	depends on DT_HAS_MICROCHIP_WDT_G1_ENABLED
	select HAS_WDT_DISABLE_AT_BOOT
	help
	  Enable WDT driver for Microchip G1 IPs.

config WDT_MCHP_WDT_G2
	bool "Microchip G2 Watchdog (WDT) Driver"
	default y
	depends on DT_HAS_MICROCHIP_WDT_G2_WDT_ENABLED
	select HAS_WDT_DISABLE_AT_BOOT
	help
	  Enable WDT driver for Microchip G2 IPs.

config WDT_MCHP_RSWDT_G1
	bool "Microchip G1 Reinforced Safety WDT \
		(RSWDT) Driver"
	default y
	depends on WDT_MCHP_WDT_G2
	depends on DT_HAS_MICROCHIP_RSWDT_G1_WDT_ENABLED
	help
	  Enable RSWDT driver for Microchip G1 IPs.
```

## dts/bindings/adc/microchip,afec-g1-adc.yaml
```yaml
# SPDX-FileCopyrightText: Copyright (c) 2026 Microchip Technology Inc.
# SPDX-License-Identifier: Apache-2.0

title: Microchip AFEC g1 driver

description: |
  Microchip AFEC g1 driver.
  The supported devices :
    - module name="AFEC" id="11147" version="S"

compatible: "microchip,afec-g1-adc"

include:
  - name: adc-controller.yaml
  - name: pinctrl-device.yaml

properties:
  reg:
    required: true

  interrupts:
    required: true

  clocks:
    required: true

  "#io-channel-cells":
    const: 1

  dmas:
    description: |
      RX dma specifier. The specifier will have a phandle
      reference to the dma controller, the channel number, and peripheral
      trigger source. The channel number is arbitrary but must not be
      reused. The number of channels available is device dependent.

      For example dmas for RX may look like
         dmas = <&xdmac 8 DMA_PERID_AFEC0_RX>;

  dma-names:
    description: |
      This should be "rx".

      For example using the example dmas, an example dma-names would be
         dma-names = "rx";

io-channel-cells:
  - input
```
