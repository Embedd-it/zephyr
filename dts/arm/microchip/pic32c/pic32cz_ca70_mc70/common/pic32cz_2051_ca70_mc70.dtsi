/*
 * SPDX-FileCopyrightText: Copyright (c) 2026 Microchip Technology Inc.
 *
 * SPDX-License-Identifier: Apache-2.0
 */

&flash0 {
	reg = <0x00400000 DT_SIZE_M(2)>;
};

&sram0 {
	reg = <0x20400000 DT_SIZE_K(512)>;
};
