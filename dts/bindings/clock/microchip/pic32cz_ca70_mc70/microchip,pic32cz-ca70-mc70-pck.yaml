## dts/bindings/flash_controller/microchip,eefc-g1-flash.yaml
```yaml
# SPDX-FileCopyrightText: Copyright (c) 2018, Aurelien Jarno
# SPDX-FileCopyrightText: Copyright (c) 2026 Microchip Technology Inc.
# SPDX-License-Identifier: Apache-2.0

title: Microchip EEFC g1 driver.

description: |
  Microchip EEFC g1 driver.

  This driver is responsible for configuring
  and managing the EEFC peripheral in Microchip microcontrollers.
  The supported devices :
    - module name="EFC" id="6450" version="Y"

compatible: "microchip,eefc-g1-flash"

include: flash-controller.yaml

properties:
  clocks:
    required: true

  "#erase-block-cells":
    type: int
    const: 2
    description: |
      Number of specifier cells used by phandle-array properties that reference this
      controller as an erase-block provider, e.g. the flash0 node's "erase-blocks" property
      (erase-blocks = <&eefc pages-count pages-size>, ...). Fixed at 2, matching the two
      cell names declared in "erase-block-cells" below.

  flash-wait-state:
    type: int
    default: 6
    enum:
      - 0
      - 1
      - 2
      - 3
      - 4
      - 5
      - 6
    description: |
      Number of flash wait states (FWS field of EEFC_FMR) to insert between accesses.
      Consumed by the SoC clock init code (soc.c) when configuring EEFC_FMR, before the
      core clock is raised, so the value must match the target core clock frequency per the
      datasheet's wait-state table. Defaults to the maximum (6) for safety at any clock speed.

# Names given to the two cells of each phandle-array entry in a consumer's "erase-blocks"
# property: the number of pages in the block and each page's size in bytes. Used by the
# driver to build the flash_pages_layout table.
erase-block-cells:
  - pages-count
  - pages-size
```

## dts/bindings/gpio/microchip,pio-g1-gpio.yaml
```yaml
# SPDX-FileCopyrightText: Copyright (c) 2021-2023, Gerson Fernando Budke <nandojve@gmail.com>
# SPDX-FileCopyrightText: Copyright (c) 2026 Microchip Technology Inc.
# SPDX-License-Identifier: Apache-2.0

title: Microchip PIO g1 driver.

description: |
  Microchip GPIO g1 driver.

  This driver is responsible for configuring
  and managing the PIO peripheral in Microchip microcontrollers.
  The supported devices :
    - module name="PIO" id="11004" version="V"

compatible: "microchip,pio-g1-gpio"

include: [gpio-controller.yaml, base.yaml]

properties:
  reg:
    required: true

  "#gpio-cells":
    const: 2

  slow-clock-divider:
    default: 0
    type: int
    min: 0
    max: 16383
    description: |
      Value written to the PIO_SCDR register. As per section 31.5.9
      of the datasheet, when the debounce filter is enabled for a pin
      it filters out pulses of duration less of 1/2 of the period
      resulting from the following equation:
        ((DIV+1)*2)*tslck
      Where DIV is the aforementioned divider and tsclk is the period
      of the slow clock.

gpio-cells:
  - pin
  - flags
```

## dts/bindings/hwinfo/microchip,chipid-g1-hwinfo.yaml
```yaml
# SPDX-FileCopyrightText: Copyright (c) 2026 Microchip Technology Inc.
# SPDX-License-Identifier: Apache-2.0

title: Microchip CHIPID g1 hwinfo driver

description: |
  Microchip CHIPID driver.

  Group g1 CHIPID driver supports following hardware peripherals:
    - module name="CHIPID" id="6417" version="ZC"

compatible: "microchip,chipid-g1-hwinfo"

include: base.yaml

properties:
  reg:
    required: true
```

## dts/bindings/i2c/microchip,twihs-g1-i2c.yaml
```yaml
# SPDX-FileCopyrightText: Copyright (c) 2026 Microchip Technology Inc.
# SPDX-License-Identifier: Apache-2.0

title: Microchip TWIHS g1 driver

description: |
  Microchip TWIHS g1 driver
  The supported devices :
    - module name="TWIHS" id="11210" version="Z"

compatible: "microchip,twihs-g1-i2c"

include:
  - name: i2c-controller.yaml
  - name: pinctrl-device.yaml

properties:
  reg:
    required: true

  interrupts:
    required: true

  clocks:
    required: true

  dmas:
    description: |
      TX & RX dma specifiers.  Each specifier will have a phandle
      reference to the dma controller, the channel number, and peripheral
      trigger source. The channel number is arbitrary but must not be
      reused. The number of channels available is device dependent.

      For example dmas for TX and RX may look like
         dmas = <&xdmac 6 DMA_PERID_TWIHS0_TX>, <&xdmac 7 DMA_PERID_TWIHS0_RX>;

  dma-names:
    description: |
      This should be "tx" and "rx" and should match the order given for
      dmas.

      For example using the example dmas, an example dma-names would be
         dma-names = "tx", "rx";
```

## dts/bindings/i2s/microchip,i2sc-g1-i2s.yaml
```yaml
# SPDX-FileCopyrightText: Copyright (c) 2026 Microchip Technology Inc.
# SPDX-License-Identifier: Apache-2.0

title: Microchip I2SC g1 driver

description: |
  Microchip I2SC g1 driver
  The supported devices :
    - module name="QSPI" id="11241" version="N"

compatible: "microchip,i2sc-g1-i2s"

include: [i2s-controller.yaml, pinctrl-device.yaml]

properties:
  reg:
    required: true

  interrupts:
    required: true

  clocks:
    required: true

  loopback:
    type: boolean
    description: |
      Connects TX to RX internally creating a loop back connection. Useful
      for testing.

  mclk-ratio:
    type: int
    description: |
      Ratio between MCLK / CLK. Value 0 disables MCLK

  dmas:
    required: true
    description: |
      TX & RX dma specifiers.  Each specifier will have a phandle
      reference to the dma controller, the channel number, and peripheral
      trigger source. The channel number is arbitrary but must not be
      reused. The number of channels available is device dependent.

      For example dmas for TX and RX may look like
         dmas = <&xdmac 1 DMA_PERID_I2SC1_TX_L>, <&xdmac 2 DMA_PERID_I2SC1_RX_L>;

  dma-names:
    required: true
    description: |
      This should be "tx" and "rx" and should match the order given for
      dmas.

      For example using the example dmas, an example dma-names would be
         dma-names = "tx", "rx";
```

## dts/bindings/mspi/microchip,qspi-g1-mspi.yaml
```yaml
# SPDX-FileCopyrightText: Copyright (c) 2026 Microchip Technology Inc.
# SPDX-License-Identifier: Apache-2.0

title: Microchip MSPI/QSPI g1 driver

description: |
  Microchip MSPI/QSPI g1 driver
  The supported devices :
    - module name="QSPI" id="11171" version="J"

compatible: "microchip,qspi-g1-mspi"

include: [base.yaml, pinctrl-device.yaml, mspi-controller.yaml]

properties:
  reg:
    required: true

  reg-names:
    required: true

  interrupts:
    required: true

  pinctrl-0:
    required: true

  pinctrl-names:
    required: true

  clocks:
    required: true

  clock-frequency:
    required: true

  dmas:
    description: |
      Each specifier consists of a phandle to the DMA controller
      and the channel number.
      The final cell is required but unused and can be set to any value.

      Example:
         dmas = <&xdmac 1 0>;

  dma-names:
    description: |
      Must be set to

      Example:
         dma-names = "txrx";
```

## dts/bindings/pinctrl/microchip,pio-g1-pinctrl.yaml
```yaml
# SPDX-FileCopyrightText: Copyright (c) 2026 Microchip Technology Inc.
# SPDX-License-Identifier: Apache-2.0
#
title: Microchip PIO g1 driver.

description: |
  Microchip pinctrl g1 driver.

  This driver is responsible for configuring
  and managing the PIO peripheral in Microchip microcontrollers.
  The supported devices :
    - module name="PIO" id="11004" version="V"

compatible: "microchip,pio-g1-pinctrl"

include: base.yaml

properties:
  "#address-cells":
    required: true
    const: 1
  "#size-cells":
    required: true
    const: 1

child-binding:
  description: |
    Each child node defines the configuration for a particular state.
  child-binding:
    description: |
      The grandchild nodes group pins that share the same pin configuration.

    include:
      - name: pincfg-node.yaml
        property-allowlist:
          - bias-pull-up
          - bias-pull-down
          - drive-strength
          - drive-open-drain

    properties:
      pinmux:
        required: true
        type: array
        description: |
          An array of pins sharing the same group properties. The pins should
          be defined using pre-defined macros.
      drive-strength:
        enum:
          - 0
          - 1
        default: 0
        description: |
          Configures the output drive strength of an output pin.
            0: low drive strength.
            1: high drive strength.
```

## dts/bindings/pwm/microchip,pwm-g2-pwm.yaml
```yaml
# SPDX-FileCopyrightText: Copyright (c) 2026 Microchip Technology Inc.
# SPDX-License-Identifier: Apache-2.0

title: Microchip PWM g2 driver.

description: |
  Microchip PWM g2 driver.

  This driver is responsible for configuring
  and managing the TC peripheral in Microchip microcontrollers for PWM configuration.
  The supported devices :
    - module name="PWM" id="6343" version="Y"

compatible: "microchip,pwm-g2-pwm"

include:
  - name: base.yaml
  - name: pwm-controller.yaml
  - name: pinctrl-device.yaml

properties:
  reg:
    required: true

  interrupts:
    required: true

  clocks:
    required: true

  prescaler:
    type: int
    required: true
    min: 0
    max: 10
    description: Clock prescaler at the input of the PWM

  divider:
    type: int
    required: true
    min: 1
    max: 255
    description: Clock divider at the input of the PWM

  "#pwm-cells":
    const: 3

pwm-cells:
  - channel
  - period
  - flags
```

## dts/bindings/reset/microchip,rstc-g2-reset.yaml
```yaml
# SPDX-FileCopyrightText: Copyright (c) 2026 Microchip Technology Inc.
# SPDX-License-Identifier: Apache-2.0

title: Microchip RSTC G2 Reset driver

description: |
  Microchip RSTC driver.

  Group g2 RSTC driver supports following hardware peripherals:
    - module name="RSTC" id="11009" version="J"

include: base.yaml

compatible: "microchip,rstc-g2-reset"

properties:
  reg:
    required: true
    description: |
      Base address and size of the RSTC register block.

  erstl:
    type: int
    default: 1
    min: 1
    max: 15
    description: |
      The duration of a reset pulse is configured as 1^(erstl+1) SLOW_CLK ticks.

  user-reset:
    type: boolean
    description: |
      Whether a low level on the NRST pin generates a user reset.
```

## dts/bindings/rtc/microchip,rtc-g3-rtc.yaml
```yaml
# SPDX-FileCopyrightText: Copyright (c) 2026 Microchip Technology Inc.
# SPDX-License-Identifier: Apache-2.0

title: Microchip RTC g3 driver.

description: |
  Microchip RTC g3 driver.

  This driver is responsible for configuring
  and managing the RTC peripheral in Microchip microcontrollers.
  The supported devices :
    - module name="RTC" id="6056" version="ZB"

compatible: "microchip,rtc-g3-rtc"

include: rtc-device.yaml

properties:
  reg:
    required: true

  interrupts:
    required: true

  clocks:
    required: true
```

## dts/bindings/sdhc/microchip,hsmci-g1-sdhc.yaml
```yaml
# SPDX-FileCopyrightText: Copyright (c) 2026 Microchip Technology Inc.
# SPDX-License-Identifier: Apache-2.0

title: Microchip HSMCI SD g1 host controller

description: |
  Microchip HSMCI g1 driver.

  This driver is responsible for configuring
  and managing the HSMCI peripheral in Microchip microcontrollers.
  The supported devices :
    - module name="HSMCI" id="6449" version="Q"

compatible: "microchip,hsmci-g1-sdhc"

include: [sdhc.yaml, pinctrl-device.yaml]

properties:
  reg:
    required: true

  pinctrl-0:
    required: true

  pinctrl-names:
    required: true

  clocks:
    required: true

  cd-gpios:
    type: phandle-array
    description: |
      Optional carrier detect signal, used as input to see if a drive
      is actually inserted in the slot.

  dmas:
    description: |
      Single DMA specifier for the shared HSMCI DMA handshake line — one
      request line serves both TX and RX; direction is selected in
      software per-transfer.

  dma-names:
    description: should be "rxtx"

examples:
  - |
    /* Definition example: PIC32CZ_CA70 SoC DTSI */
    &hsmci {
       dmas = <&xdmac 0 DMA_PERID_HSMCI_TX_RX>;
      dma-names = "rxtx";
    };
```

## dts/bindings/serial/microchip,uart-g2-uart.yaml
```yaml
# SPDX-FileCopyrightText: Copyright (c) 2026 Microchip Technology Inc.
# SPDX-License-Identifier: Apache-2.0

title: Microchip UART controller

description: |
  Microchip UART driver.

  Group g2 UART driver supports following hardware peripherals:
    - module name="UART" id="6418" version="R"

compatible: microchip,uart-g2-uart

include:
  - name: uart-controller.yaml
  - name: pinctrl-device.yaml

properties:
  reg:
    required: true

  interrupts:
    required: true

  clocks:
    required: true

  use-pck4:
    type: boolean
    description: |
      Use PCK4 rather than the peripheral clock to generate the baudrate.

  channel-mode:
    type: string
    enum:
      - "normal"
      - "automatic-echo"
      - "local-loopback"
      - "remote-loopback"
    default: "normal"
    description: |
      Channel mode:
        - In normal mode the USART simply sends on TX and receives on RX.
        - In echo mode the receiver input is connected to the TX pin.
        - In local loopback mode the transmitter output is connected
            to the receiver input.
        - In remote loopback mode the RX pin is internally connected to
            the TX pin.

  dmas:
    description: |
      TX & RX dma specifiers.  Each specifier will have a phandle
      reference to the dma controller, the channel number, and peripheral
      trigger source. The channel number is arbitrary but must not be
      reused. The number of channels available is device dependent.

      For example dmas for TX and RX may look like
         dmas = <&xdmac 1 DMA_PERID_UART0_TX>, <&xdmac 2 DMA_PERID_UART0_RX>;

  dma-names:
    description: |
      This should be "tx" and "rx" and should match the order given for
      dmas.

examples:
  - |
    /* Definition example: PIC32CZ_CA70 SoC DTSI */
    &uart4 {
      dmas = <&xdmac 8 DMA_PERID_UART4_TX>, <&xdmac 9 DMA_PERID_UART4_RX>;
      dma-names = "tx", "rx";
    };
```
