## dts/bindings/clock/microchip/pic32cz_ca70_mc70/microchip,pic32cz-ca70-mc70-pck.yaml
```yaml
# SPDX-FileCopyrightText: Copyright (c) 2026 Microchip Technology Inc.
# SPDX-License-Identifier: Apache-2.0

title: PIC32CZ_CA70 programmable clock controller

description: |
  Microchip Programmable Clock Controller (PCK)

  The PMC node in the DTS is expected to have a `pck` subnode
  with a child for each generic clock that needs to be configured
  in the system.

compatible: "microchip,pic32cz-ca70-mc70-pck"

include: base.yaml

child-binding:
  description: Programmable clock configuration
  properties:
    reg:
      type: array
      required: true
      description: |
        The Programmable clock identifier index.

    source:
      type: string
      default: "mainck"
      enum:
        - "slowck"
        - "mainck"
        - "pllack"
        - "upllck"
        - "hostck"
      description: |
        Clock source selected for the programmable clock.

    prescaler:
      type: int
      default: 1
      min: 1
      max: 256
      description: |
        Prescaler applied to the selected source to generate the
        programmable clock output.

examples:
  - |
    /* Definition example: PIC32CZ_CA70 SoC DTSI
     * In this example `pck4` is the programmable clock for the
     * peripheral USART baudrate generation, using the PLLACK as
     * source with a prescaler of 15.
     */
    pck: pck {
      compatible = "microchip,pic32cz-ca70-pck";

      #address-cells = <1>;
      #size-cells = <0>;

      pck4: pck@4 {
        reg = <CLOCK_MCHP_PCK4_IDX>;
        source = "pllack";
        prescaler = <15>;
      };
    };
```

## dts/bindings/clock/microchip/pic32cz_ca70_mc70/microchip,pic32cz-ca70-mc70-pmc.yaml
```yaml
# SPDX-FileCopyrightText: Copyright (c) 2026 Microchip Technology Inc.
# SPDX-License-Identifier: Apache-2.0

title: PIC32CZ_CA70 PMC driver.

description: |
  Microchip PIC32CZ_CA70 PMC driver.

  This driver is responsible for configuring
  and managing the PMC peripheral in Microchip microcontrollers.
  The supported devices :
    - module name="PMC" id="44006" version="P"

  The Power Management Controller (PMC) optimizes power consumption by
  controlling all system and user peripheral clocks. The PMC enables/disables
  the clock inputs to many of the peripherals and the processor.

  To specify the clocks in a peripheral the clock type and peripheral id must
  be specified. Helper macros are defined for each possible configuration.

compatible: "microchip,pic32cz-ca70-mc70-pmc"

include: [clock-controller.yaml, base.yaml]

properties:
  reg:
    required: true
    description: |
      Register blocks for the PMC, SUPC, UTMI and Bus Matrix peripherals,
      identified by reg-names.
  reg-names:
    required: true
    description: |
      Names for each entry in reg: "pmc", "supc", "utmi", "matrix".

  "#clock-cells":
    const: 1
    description: |
      from common clock binding; shall be set to 1. It contains two entries
      packed in a word: the type of the clock (core, system, peripheral or
      generated) and the peripheral identification index as provided by
      the datasheet.

  tc0-pck7:
    type: boolean
    description: |
      Whether to use PCK7 instead of PCK6 for the TC0 peripheral.

  i2sc0-gclk:
    type: boolean
    description: |
      Whether to use GCLK instead of the peripheral clock for the I2SC0
      peripheral.

  i2sc1-gclk:
    type: boolean
    description: |
      Whether to use GCLK instead of the peripheral clock for the I2SC1
      peripheral.

clock-cells:
  - subsystem

examples:
  - |
     /* Definition example: PIC32CZ_CA70 SoC DTSI
      * In this example `CLOCK_MCHP_USART2` is then resolved to
      * `MCHP_CLOCK_DERIVE_ID(SUBSYS_TYPE_PERIPHERAL, 15)`, where
      * `SUBSYS_TYPE_PERIPHERAL` is the clock type and 15 is the peripheral id.
      * The peripheral id is usually described in the datasheet at Product Mapping
      * figure.
      */
     usart2: usart2@4002c000 {
       clocks = <&pmc CLOCK_MCHP_USART2>;
     };
```

## dts/bindings/comparator/microchip,acc-g1-comparator.yaml
```yaml
# SPDX-FileCopyrightText: Copyright (c) 2026 Microchip Technology Inc.
# SPDX-License-Identifier: Apache-2.0

title: Microchip g1 Analog Comparator

description: |
  Microchip ACC g1 peripheral exposed via the Comparator API.

  This driver is responsible for configuring and managing the ACC peripheral
  in Microchip microcontrollers.
  The supported devices :
    - module name="ACC" id="6490" version="H"

compatible: "microchip,acc-g1-comparator"

include:
  - name: base.yaml
  - name: pinctrl-device.yaml

properties:
  reg:
    required: true
    description: |
      Base address of AC peripheral and its size

  selminus:
    type: string
    default: "ts"
    description: |
      Selection for minus comparator input
    enum:
      - "ts"
      - "vrefp"
      - "dac0"
      - "dac1"
      - "afe0-ad0"
      - "afe0-ad1"
      - "afe0-ad2"
      - "afe0-ad3"

  selplus:
    type: string
    default: "afe0-ad0"
    description: |
      Selection for plus comparator input
    enum:
      - "afe0-ad0"
      - "afe0-ad1"
      - "afe0-ad2"
      - "afe0-ad3"
      - "afe0-ad4"
      - "afe0-ad5"
      - "afe1-ad0"
      - "afe1-ad1"

  invert-output:
    type: boolean
    description: |
      Whether the comparator output is directly processed or inverted beforehand

  hysteresis:
    type: string
    default: "none"
    description: |
      Input hysteresis selection
    enum:
      - "none"
      - "low"
      - "medium"
      - "high"

  current:
    type: string
    default: "low-power"
    description: |
      Current selection. High speed comes at the cost of a higher power consumption
    enum:
      - "low-power"
      - "high-speed"
```

## dts/bindings/counter/microchip,rtc-g2-counter.yaml
```yaml
# SPDX-FileCopyrightText: Copyright (c) 2026 Microchip Technology Inc.
# SPDX-License-Identifier: Apache-2.0

title: Microchip RTC counter driver.

description: |
  Microchip RTC g2 peripheral exposed via the Counter API.

  Converts the RTC's internal BCD calendar registers to/from a Unix
  timestamp and exposes that value as the counter's tick count. Mutually
  exclusive with the microchip,rtc-g2 (RTC subsystem) driver on the same
  physical peripheral instance; only one of the two compatibles may be
  in effect on a given RTC node at a time.

  This driver is responsible for configuring
  and managing the RTC peripheral in Microchip microcontrollers.
  The supported devices :
    - module name="RTC" id="6056" version="ZB"

compatible: "microchip,rtc-g2-counter"

include: rtc-device.yaml


properties:
  reg:
    required: true

  interrupts:
    required: true

  clocks:
    required: true
```

## dts/bindings/counter/microchip,tc-g3-counter.yaml
```yaml
# SPDX-FileCopyrightText: Copyright (c) 2026 Microchip Technology Inc.
# SPDX-License-Identifier: Apache-2.0

title: Microchip TC counter g3 driver.

description: |
  Microchip TC counter g3 driver.

  This driver is responsible for configuring
  and managing the TC peripheral in Microchip microcontrollers.
  The supported devices :
    - module name="TC" id="6082" version="ZL"

compatible: "microchip,tc-g3-counter"

include:
  - name: base.yaml
  - name: pinctrl-device.yaml

properties:
  interrupts:
    required: true

  clocks:
    required: true

  channel:
    type: int
    enum:
      - 0
      - 1
      - 2
    description: |
      Timer / Counter channel to use, channel 0 is the default.
      Valid range: 0 - 2

      Each channel is an independent counting timeline (own TC_CV, top
      value and IRQ) and is therefore its own device instance.

  clk:
    type: string
    default: "timer_clock1"
    enum:
      - "timer_clock1"
      - "timer_clock2"
      - "timer_clock3"
      - "timer_clock4"
      - "timer_clock5"
      - "xc0"
      - "xc1"
      - "xc2"
    description: |
      Clock source selection as defined by TCCLKS bit-field of TC_CMR
      register. Consult the datasheet for the details.

  external-frequency:
    type: int
    description: |
      Frequency for the external clock sources XC0, XC1 and XC2.

  nodivclk:
    type: boolean
    description: |
      If set to true the `clk` property is ignored. Instead the TC module is
      driven directly via MCLK.

  reg-cmr:
    type: int
    description: |
      Alternate value of the CMR (Channel Mode Register) register.
      If specified this value will be written to the register during driver
      instance initialization instead of the default. It can be used to
      configure the timer / counter in the custom mode. Together with other
      properties like channel-num, pinctrl-0 this allows e.g. to configure
      the driver to count events generated on the TIOA, TIOB signal connected
      to the external pin.

  reg-rc:
    type: int
    description: |
      Register C compare/match value. RC can be used as compare/match unit
      for an specific timer unit. Their use depends on how timer channel
      is configured,see reg-cmr. It can be used as trigger for both input
      capture or counter mode, or even as event source. The RC register
      behavior is SoC dependent. For more information and use cases,
      check SoC datasheet and application notes.

  use-pck7:
    type: boolean
    description: |
      Use PCK7 as programmable clock rather than the default PCK6.
      Only configurable for TC0.

counter-capture-cells:
  - channel
  - flags
```

## dts/bindings/crypto/microchip,aes-g2-crypto.yaml
```yaml
# SPDX-FileCopyrightText: Copyright (c) 2026 Microchip Technology Inc.
# SPDX-License-Identifier: Apache-2.0

title: Microchip g2 AES Controller Driver

description: |
  Microchip Advanced Encryption Standard (AES) calculator peripheral.

  Group g2 AES driver supports following hardware peripherals:
    - module name="AES" id="6149" version="T"


compatible: "microchip,aes-g2-crypto"

include: [base.yaml]

properties:
  reg:
    required: true

  clocks:
    required: true

  dmas:
    description: |
      Input (TX) and output (RX) DMA specifiers. Both are meaningful
      (and required) when CONFIG_CRYPTO_MCHP_AES_G2_DMA is enabled.

  dma-names:
    description: |
      Must be "tx" and "rx", matching the order given in "dmas".

examples:
  - |
    /* Definition example: PIC32CZ_CA70 SoC DTSI */
    &aes {
      status = "okay";
      dmas = <&xdmac 12 DMA_PERID_AES_TX>, <&xdmac 13 DMA_PERID_AES_RX>;
      dma-names = "tx", "rx";
    };
```

## dts/bindings/crypto/microchip,icm-g1-crypto.yaml
```yaml
# SPDX-FileCopyrightText: Copyright (c) 2026 Microchip Technology Inc.
# SPDX-License-Identifier: Apache-2.0

title: Microchip G1 ICM Controller Driver

description: |
  Microchip Integrity Check Monitor (i.e. hashing peripheral).
  Supports SHA224 and SHA256 algorithms.

  Group g1 ICM driver supports following hardware peripherals:
    - module name="ICM" id="11105" version="F"


compatible: "microchip,icm-g1-crypto"

include: [base.yaml]

properties:
  reg:
    required: true

  clocks:
    required: true
```

## dts/bindings/dac/microchip,dacc-g1-dac.yaml
```yaml
# SPDX-FileCopyrightText: Copyright (c) 2026 Microchip Technology Inc.
# SPDX-License-Identifier: Apache-2.0

title: Microchip DACC g1 driver.

description: |
  Microchip DACC g1 driver.
  The supported devices :
    - module name="DACC" id="11246" version="E"

compatible: "microchip,dacc-g1-dac"

include:
  - name: dac-controller.yaml
  - name: pinctrl-device.yaml

properties:
  reg:
    required: true

  clocks:
    required: true

  prescaler:
    type: int
    default: 15
    description: |
      Peripheral Clock to DAC Clock Ratio. Prescaler value is calculated as
      PRESCAL = (MCK / DACClock) - 2. Should be in range from 0 to 15. The
      value will be written to DACC_MR.PRESCALER bit-field. The property is
      applicable only to CA70 series devices.

  "#io-channel-cells":
    const: 1

io-channel-cells:
  - output
```

## dts/bindings/dma/microchip,xdmac-g1-dma.yaml
```yaml
# SPDX-FileCopyrightText: Copyright (c) 2026 Microchip Technology Inc.
# SPDX-License-Identifier: Apache-2.0

title: Microchip XDMAC g1 driver

description: |
  Microchip XDMAC g1 driver
  The supported devices :
    - module name="XDMAC" id="11161" version="K"

compatible: "microchip,xdmac-g1-dma"

include: dma-controller.yaml

properties:
  reg:
    required: true

  interrupts:
    required: true

  clocks:
    required: true

  "#dma-cells":
    const: 2

  dma-channels:
    type: int
    required: true
    description: |
      The number of DMA channels available in the DMA controller.

dma-cells:
  - channel
  - perid
```

## dts/bindings/ethernet/mdio/microchip,gmac-g2-mdio.yaml
```yaml
# SPDX-FileCopyrightText: Copyright (c) 2021 IP-Logix Inc.
# SPDX-FileCopyrightText: Copyright (c) 2026 Microchip Technology Inc.
# SPDX-License-Identifier: Apache-2.0

title: Microchip GMAC/MDIO g2 driver

description: |
  Microchip GMAC/MDIO g2 driver
  The supported devices :
    - module name="GMAC" id="11046" version="S"

compatible: "microchip,gmac-g2-mdio"

include:
  - name: mdio-controller.yaml
  - name: pinctrl-device.yaml
```

## dts/bindings/ethernet/microchip,gmac-g2-eth.yaml
```yaml
# SPDX-FileCopyrightText: Copyright (c) 2021-2023 Gerson Fernando Budke <nandojve@gmail.com>
# SPDX-FileCopyrightText: Copyright (c) 2026 Microchip Technology Inc.
# SPDX-License-Identifier: Apache-2.0

title: Microchip GMAC g2 driver

description: |
  Microchip GMAC g2 driver
  The supported devices :
    - module name="GMAC" id="11046" version="S"

compatible: "microchip,gmac-g2-eth"

include:
  - name: ethernet-controller.yaml
  - name: pinctrl-device.yaml

properties:
  phy-handle:
    required: true

  num-queues:
    type: int
    required: true
    description: |
      Number of hardware TX and RX queues.

  phy-connection-type:
    default: "rmii"

  ref-clk-source:
    type: string
    default: "internal"
    description: |
      Specifies the source for the ethernet MAC reference clock.
    enum:
      - "internal"
      - "external"
```

## dts/bindings/ethernet/microchip,gmac-g2-ethernet-controller.yaml
```yaml
# SPDX-FileCopyrightText: Copyright (c) 2026 Microchip Technology Inc.
# SPDX-License-Identifier: Apache-2.0

title: Microchip GMAC family Ethernet Controller

description: |
  Contains the Ethernet MAC and the MDIO as child nodes.
  The supported devices :
    - module name="GMAC" id="11046" version="S"

compatible: "microchip,gmac-g2-ethernet-controller"

include: base.yaml

properties:
  reg:
    required: true
```
