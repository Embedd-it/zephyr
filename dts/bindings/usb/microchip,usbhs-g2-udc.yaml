## dts/bindings/usb/microchip,usbhs-g2-udc.yaml
```yaml
# SPDX-FileCopyrightText: Copyright (c) 2018 Aurelien Jarno
# SPDX-FileCopyrightText: Copyright (c) 2026 Gerson Fernando Budke <nandojve@gmail.com>
# SPDX-FileCopyrightText: Copyright (c) 2026 Microchip Technology Inc.
# SPDX-License-Identifier: Apache-2.0

title: Microchip USBHS g2 device driver

description: |
    PIC32CZ CA70 Family USB (USBHS) in device mode

    The USBHS controller has two memory regions:
    - "core": USBHS register block
    - "fifo": Dual-Port RAM (DPRAM) for endpoint FIFOs

    The USBHS has 10 hardware endpoints (EP0-EP9). Each hardware endpoint has
    a single configuration register, so it cannot be used as both IN and OUT
    at the same time. The endpoints beyond EP0 are therefore split into a
    fixed IN block followed by a fixed OUT block, sized by num-in-endpoints
    and num-out-endpoints.

    Only one between device and host may be enabled at the same time.

    Group g2 USBHS driver supports following hardware peripherals:
      - module name="USBHS" id="11292" version="G"

compatible: "microchip,usbhs-g2-udc"

include:
  - name: usb-ep.yaml

properties:
  interrupts:
    required: true

  clocks:
    required: true

  maximum-speed:
    default: "high-speed"

  reg:
    required: true
    description: |
      Register regions for the USBHS controller.
      Contain two entries in order:
        - core registers
        - fifo DPRAM

  reg-names:
    required: true
    description: |
      Names for the register regions. Must be "core" and "fifo".

  num-in-endpoints:
    required: true
    description: |
      Number of IN endpoints including EP0 IN. These occupy hardware
      endpoints 0 through (num-in-endpoints - 1).

  num-out-endpoints:
    required: true
    description: |
      Number of OUT endpoints including EP0 OUT. These occupy hardware
      endpoint 0 and the endpoints immediately following the IN block,
      i.e. num-in-endpoints through (num-in-endpoints + num-out-endpoints - 2).

examples:
  - |
    /* Definition example: PIC32CZ_CA70 SoC DTSI */
    usbhs: usb@40038000 {
      compatible = "microchip,usbhs-g2-udc";
      reg = <0x40038000 0x4000>, <0xa0100000 0x50000>;
      reg-names = "core", "fifo";
      interrupts = <34 0>;
      interrupt-names = "usbhs";
      clocks = <&pmc CLOCK_MCHP_USBHS>;
      clock-names = "mclk";
      num-bidir-endpoints = <1>;
      num-in-endpoints = <6>;
      num-out-endpoints = <5>;
      status = "disabled";
    };
```

## dts/bindings/usb/microchip,usbhs-g2-uhc.yaml
```yaml
# SPDX-FileCopyrightText: Copyright (c) 2026 Microchip Technology Inc.
# SPDX-License-Identifier: Apache-2.0

title: Microchip USBHS g2 host driver

description: |
    PIC32CZ CA70 Family USB (USBHS) in host mode

    The USBHS controller has two memory regions:
    - "core": USBHS register block
    - "fifo": Dual-Port RAM (DPRAM) for endpoint FIFOs

    Only one between device and host may be enabled at the same time.

    Group g2 USBHS driver supports following hardware peripherals:
      - module name="USBHS" id="11292" version="G"

compatible: "microchip,usbhs-g2-uhc"

include:
  - name: usb-controller.yaml

properties:
  interrupts:
    required: true

  clocks:
    required: true

  maximum-speed:
    default: "high-speed"

  reg:
    required: true
    description: |
      Register regions for the USBHS controller.
      Contain two entries in order:
        - core registers
        - fifo DPRAM

  reg-names:
    required: true
    description: |
      Names for the register regions. Must be "core" and "fifo".

examples:
  - |
    /* Definition example: PIC32CZ_CA70 SoC DTSI */
    usbhs: usb@40038000 {
      compatible = "microchip,usbhs-g2-uhc";
      reg = <0x40038000 0x4000>, <0xa0100000 0x50000>;
      reg-names = "core", "fifo";
      interrupts = <34 0>;
      interrupt-names = "usbhs";
      clocks = <&pmc CLOCK_MCHP_USBHS>;
      clock-names = "mclk";
      status = "disabled";
    };
```

## dts/bindings/watchdog/microchip,rswdt-g1-wdt.yaml
```yaml
# SPDX-FileCopyrightText: Copyright (c) 2026 Microchip Technology Inc.
# SPDX-License-Identifier: Apache-2.0

title: Microchip RSWDT g1 driver

description: |
  Microchip RSWDT g1 driver.

  This driver is responsible for configuring
  and managing the RSWDT peripheral in Microchip microcontrollers.
  The supported devices :
    - module name="RSWDT" id="11110" version="D"

compatible: "microchip,rswdt-g1-wdt"

include: base.yaml

properties:
  reg:
    required: true

  interrupts:
    required: true

  clocks:
    required: true
```

## dts/bindings/watchdog/microchip,wdt-g2-wdt.yaml
```yaml
# SPDX-FileCopyrightText: Copyright (c) 2026 Microchip Technology Inc.
# SPDX-License-Identifier: Apache-2.0

title: Microchip WDT g2 driver.

description: |
  Microchip WDT g2 driver.

  This driver is responsible for configuring
  and managing the WDT peripheral in Microchip microcontrollers.
  The supported devices :
    - module name="WDT" id="6080" version="N"

compatible: "microchip,wdt-g2-wdt"

include: base.yaml

properties:
  reg:
    required: true

  interrupts:
    required: true

  clocks:
    required: true
```

## soc/microchip/pic32c/pic32cz_ca70_mc70/Kconfig.soc
```kconfig
# Copyright (c) 2025 Microchip Technology Inc.
# SPDX-License-Identifier: Apache-2.0

config SOC_FAMILY_MICROCHIP_PIC32CZ_CA70_MC70
	bool

config SOC_FAMILY
	default "microchip_pic32cz_ca70_mc70" if SOC_FAMILY_MICROCHIP_PIC32CZ_CA70_MC70

rsource "*/Kconfig.soc"
```

## soc/microchip/pic32c/pic32cz_ca70_mc70/pic32cz_ca70/Kconfig.soc
```kconfig
# SPDX-FileCopyrightText: Copyright (c) 2026 Microchip Technology Inc.
# SPDX-License-Identifier: Apache-2.0

config SOC_SERIES_PIC32CZ_CA70
	bool
	select SOC_FAMILY_MICROCHIP_PIC32CZ_CA70_MC70
	help
	  Enable support for Microchip PIC32CZ CA70 Cortex-M7 microcontrollers.

config SOC_SERIES
	default "pic32cz_ca70" if SOC_SERIES_PIC32CZ_CA70

config SOC_PIC32CZ2051CA70064
	bool
	select SOC_SERIES_PIC32CZ_CA70

config SOC_PIC32CZ2051CA70100
	bool
	select SOC_SERIES_PIC32CZ_CA70

config SOC_PIC32CZ2051CA70144
	bool
	select SOC_SERIES_PIC32CZ_CA70

config SOC_PIC32CZ1038CA70064
	bool
	select SOC_SERIES_PIC32CZ_CA70

config SOC_PIC32CZ1038CA70100
	bool
	select SOC_SERIES_PIC32CZ_CA70

config SOC_PIC32CZ1038CA70144
	bool
	select SOC_SERIES_PIC32CZ_CA70

config SOC_PIC32CZ5125CA70064
	bool
	select SOC_SERIES_PIC32CZ_CA70

config SOC_PIC32CZ5125CA70100
	bool
	select SOC_SERIES_PIC32CZ_CA70

config SOC_PIC32CZ5125CA70144
	bool
	select SOC_SERIES_PIC32CZ_CA70

config SOC
	default "pic32cz2051ca70064" if SOC_PIC32CZ2051CA70064
	default "pic32cz2051ca70100" if SOC_PIC32CZ2051CA70100
	default "pic32cz2051ca70144" if SOC_PIC32CZ2051CA70144
	default "pic32cz1038ca70064" if SOC_PIC32CZ1038CA70064
	default "pic32cz1038ca70100" if SOC_PIC32CZ1038CA70100
	default "pic32cz1038ca70144" if SOC_PIC32CZ1038CA70144
	default "pic32cz5125ca70064" if SOC_PIC32CZ5125CA70064
	default "pic32cz5125ca70100" if SOC_PIC32CZ5125CA70100
	default "pic32cz5125ca70144" if SOC_PIC32CZ5125CA70144
```

## tests/crypto/crypto_hash/boards/pic32cz_ca70_cult.conf
```kconfig
# SPDX-FileCopyrightText: Copyright (c) 2026 Microchip Technology Inc.
# SPDX-License-Identifier: Apache-2.0

CONFIG_TEST_CRYPTO_IO_ALIGNMENT_BYTES=128
```

## tests/drivers/flash/common/boards/pic32cz_ca70_cult.conf
```kconfig
# SPDX-FileCopyrightText: Copyright (c) 2026 Microchip Technology Inc.
# SPDX-License-Identifier: Apache-2.0
#
CONFIG_TEST_DRIVER_FLASH_SIZE=2097152
```

## tests/drivers/i2s/i2s_api/boards/pic32cz_ca70_cult.conf
```kconfig
# SPDX-FileCopyrightText: Copyright (c) 2026 Microchip Technology Inc.
# SPDX-License-Identifier: Apache-2.0

CONFIG_I2S_TEST_ALLOWED_DATA_OFFSET=8
CONFIG_I2S_TEST_ALLOW_VARIABLE_OFFSET=y
```
