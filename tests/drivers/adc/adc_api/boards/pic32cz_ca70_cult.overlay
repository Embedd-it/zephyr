/*
 * SPDX-FileCopyrightText: Copyright (c) 2026 Microchip Technology Inc.
 *
 * SPDX-License-Identifier: Apache-2.0
 */

/ {
	zephyr,user {
		io-channels = <&afec0 7>;
	};
};

/** Connect VDD to J302.1 (Vrefin) */
/** Using Arduino ADC0 (J403_1 / AFEC0_AD7) */
&afec0 {
	pinctrl-0 = <&arduino_header_adc0>;
	pinctrl-names = "default";
	#address-cells = <1>;
	#size-cells = <0>;
	status = "okay";

	channel@7 {
		reg = <7>;
		zephyr,gain = "ADC_GAIN_1";
		zephyr,reference = "ADC_REF_EXTERNAL0";
		zephyr,acquisition-time = <0/*ADC_ACQ_TIME_DEFAULT*/>;
		zephyr,resolution = <12>;
	};
};
