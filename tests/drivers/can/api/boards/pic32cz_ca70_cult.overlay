/*
 * SPDX-FileCopyrightText: Copyright (c) 2026 Microchip Technology Inc.
 *
 * SPDX-License-Identifier: Apache-2.0
 */

&can0 {
	pinctrl-0 = <&can0_default>;
	pinctrl-names = "default";
	status = "okay";
};
