/*
 * SPDX-FileCopyrightText: Copyright (c) 2026 Microchip Technology Inc.
 *
 * SPDX-License-Identifier: Apache-2.0
 */

/ {
	aliases {
		sdhc0 = &hsmci;
	};
};

&hsmci {
	pinctrl-0 = <&hsmci_default>;
	pinctrl-names = "default";
	status = "okay";

	mmc {
		compatible = "zephyr,sdmmc-disk";
		disk-name = "SD";
		status = "okay";
	};
};
