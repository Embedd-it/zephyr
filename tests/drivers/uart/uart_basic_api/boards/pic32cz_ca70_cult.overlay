/*
 * SPDX-FileCopyrightText: Copyright (c) 2026 Microchip Technology Inc.
 *
 * SPDX-License-Identifier: Apache-2.0
 */

/ {
	chosen {
		zephyr,console = &uart4;
		zephyr,shell-uart = &uart4;
	};
};

&uart4 {
	current-speed = <115200>;

	pinctrl-0 = <&uart4_default>;
	pinctrl-names = "default";

	status = "okay";
};
